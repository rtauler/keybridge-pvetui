## main/Kconfig.projbuild
```kconfig
menu "Keybridge Configuration"
    config APP_WIFI_SSID
        string "Wi-Fi SSID"
        default "AWACS"

    config APP_WIFI_PASSWORD
        string "Wi-Fi password"
        default "j9t*Dsx86AM@3R.XypvkuGQC4eoLkZ"

    config APP_WIFI_MAXIMUM_RETRY
        int "Wi-Fi maximum retry count"
        range 1 100
        default 10

    config APP_BLE_DEVICE_NAME
        string "BLE device name"
        default "Keybridge PVE"

    config APP_HTTP_PORT
        int "HTTP server port"
        range 1 65535
        default 80
endmenu
```

## sdkconfig.defaults
```kconfig
CONFIG_PARTITION_TABLE_SINGLE_APP_LARGE=y

CONFIG_BT_ENABLED=y
CONFIG_BTDM_CTRL_MODE_BLE_ONLY=y
CONFIG_BTDM_CTRL_MODE_BR_EDR_ONLY=n
CONFIG_BTDM_CTRL_MODE_BTDM=n
CONFIG_BT_BLUEDROID_ENABLED=n
CONFIG_BT_NIMBLE_ENABLED=y
CONFIG_BT_NIMBLE_NVS_PERSIST=y
CONFIG_BT_NIMBLE_ROLE_PERIPHERAL=y
CONFIG_BT_NIMBLE_ROLE_CENTRAL=n
CONFIG_BT_NIMBLE_ROLE_BROADCASTER=y
CONFIG_BT_NIMBLE_ROLE_OBSERVER=n
CONFIG_BT_NIMBLE_HID_SERVICE=y
```
